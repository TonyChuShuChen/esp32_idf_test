## components/tests/Kconfig
```kconfig
menu "TESTS"

config FP_TEST_ENABLE
    bool "Enable test fp"
    default "y"
    help
        For FPGA single core CPU which has no FP support, fp test should be disabled.

endmenu
```
